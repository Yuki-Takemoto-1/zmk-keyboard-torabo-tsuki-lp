#include "../../../config/torabo_tsuki_lp.dtsi"
#include <input/processors.dtsi>
#include <dt-bindings/zmk/input_transform.h>

&zip_temp_layer {
    require-prior-idle-ms = <350>;
    excluded-positions = <
        25 // A
        26 // S
        27 // D
        28 // F
        33 // J
        34 // K
        35 // L
        36 // ;
    >;
};

&trackball_listener {
    input-processors = <
        &zip_xy_transform (INPUT_TRANSFORM_X_INVERT | INPUT_TRANSFORM_Y_INVERT)
        &zip_temp_layer 5 10000
    >;

};
